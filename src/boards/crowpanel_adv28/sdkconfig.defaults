## src/main/Kconfig.projbuild
```kconfig
menu "Kybotos"

    choice KYBOTOS_BOARD
        prompt "Target board"
        default KYBOTOS_BOARD_WAVESHARE_LCD28
        help
            The board the firmware is built for (Phase 24). Pins and features come from
            src/components/board/boards/<board>.h. Do not change this in menuconfig: pass
            -DKYBOTOS_BOARD=<board> (or use scripts/fw.sh), which applies
            src/boards/<board>/sdkconfig.defaults. Each board needs its own build directory
            and sdkconfig; src/CMakeLists.txt stops when they disagree.

        config KYBOTOS_BOARD_WAVESHARE_LCD28
            bool "Waveshare ESP32-S3-Touch-LCD-2.8"
        config KYBOTOS_BOARD_CROWPANEL_ADV28
            bool "Elecrow CrowPanel Advance 2.8\" (V1.2)"
    endchoice

    config KYBOTOS_BOARD_NAME
        string
        default "waveshare_lcd28" if KYBOTOS_BOARD_WAVESHARE_LCD28
        default "crowpanel_adv28" if KYBOTOS_BOARD_CROWPANEL_ADV28

    config KYBOTOS_WASM_CYCLE_TEST
        bool "Run app start/stop cycle test at boot (leak check)"
        default n
        help
            Before showing the launcher menu, automatically run 10
            start/stop cycles of mp3player.wasm with playback forced
            mid-cycle (logging free heap per cycle) and a corrupted-wasm
            load test. For leak verification (Phase 5C/6B).

    config KYBOTOS_SERIAL_CMD
        bool "Enable the serial command console (USB Serial/JTAG)"
        default y
        help
            Read one-line commands from the USB Serial/JTAG port and answer
            with log lines tagged KBCMD. Used by scripts/device-regress.sh to
            run the on-device regression without touching the screen:
            ping / ls / run <app> / stop / heap.
            Phase 22 adds UI injection for scripted regressions
            (tap / hold / drag / key back|home), a dump of the app's text
            slots (texts) and rm <app> to delete an app from the SD card.
            Real touches and the power key keep working as before.


    config KYBOTOS_SD_SKIP_SDMMC_PROBE
        bool "Skip the SDMMC probe and mount the SD card via SDSPI directly"
        default y if SPIRAM
        default n
        help
            The SDMMC probe in sdcard.cpp has never succeeded on this board; it
            only fails and falls back to SDSPI. With PSRAM enabled it stops
            returning at all and the board reboots in a TG1WDT loop
            (Phase 12 experiment E5). Skipping the probe makes PSRAM usable.

            The cost is that the card is always mounted over SDSPI at
            11.43 MHz instead of SDMMC at 20 MHz. Before Phase 15 that also cut
            the internal largest free block from 31,744 to 15,360 and stopped
            every WASM app from starting; that is no longer a concern because
            the linear memory now comes from PSRAM.

            Phase 15 step 4 investigates why the probe hangs. Revisit this
            default once that has an answer.

    config KYBOTOS_SCREENSAVER
        bool "Blank the launcher menu when idle (screensaver / backlight off)"
        default y
        help
            While the launcher menu is on screen (no WASM app running), show a
            black screensaver with a slowly drifting dot after
            KYBOTOS_SCREENSAVER_SEC without a touch, then turn the LCD
            backlight off after KYBOTOS_BACKLIGHT_OFF_SEC. This avoids the
            image retention that a permanently displayed menu causes.
            A touch (or a short power-key press) restores the menu; the waking
            touch is swallowed by the screensaver overlay so it cannot launch
            an app by accident. Running apps are never affected: the timers
            only act while the menu screen is the active screen.

    config KYBOTOS_SCREENSAVER_SEC
        int "Idle seconds before the screensaver starts"
        depends on KYBOTOS_SCREENSAVER
        range 5 3600
        default 60

    config KYBOTOS_BACKLIGHT_OFF_SEC
        int "Idle seconds before the backlight turns off"
        depends on KYBOTOS_SCREENSAVER
        range 5 7200
        default 180
        help
            Counted from the same idle timer as the screensaver, so it must be
            larger than KYBOTOS_SCREENSAVER_SEC to have a screensaver stage.

endmenu
```
